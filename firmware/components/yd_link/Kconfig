## firmware/components/yd_link/Kconfig
```kconfig
menu "KeyRelay log language"

    choice YD_LOG_LANG
        prompt "Language of the serial log messages"
        default YD_LOG_LANG_EN
        help
            Language of the log messages printed on the serial console (for example in screen).
            Applies to both the receiver and the desk unit.

        config YD_LOG_LANG_EN
            bool "English"

        config YD_LOG_LANG_JA
            bool "Japanese (日本語)"
    endchoice

endmenu
```

## firmware/desk_unit/sdkconfig.defaults
```kconfig
CONFIG_IDF_TARGET="esp32s3"
# ログはUART0（ボードの「COM」側USB-C）に出す。ネイティブUSBはYubiKey用
CONFIG_ESP_CONSOLE_UART_DEFAULT=y
CONFIG_ESP_CONSOLE_SECONDARY_NONE=y
CONFIG_ESPTOOLPY_FLASHSIZE_8MB=y
# ---- BLE（NimBLE） ----
CONFIG_BT_ENABLED=y
CONFIG_BT_NIMBLE_ENABLED=y
CONFIG_BT_BLUEDROID_ENABLED=n
CONFIG_BT_NIMBLE_MAX_CONNECTIONS=1
CONFIG_BT_NIMBLE_NVS_PERSIST=y
CONFIG_BT_NIMBLE_SM_SC=y
CONFIG_BT_NIMBLE_LOG_LEVEL_WARNING=y
CONFIG_BT_NIMBLE_MSYS_1_BLOCK_COUNT=24
# NimBLE + USB でアプリが大きくなるので1.5MBのアプリ領域に
CONFIG_PARTITION_TABLE_CUSTOM=y
CONFIG_PARTITION_TABLE_CUSTOM_FILENAME="partitions.csv"
# app_main でUSB列挙と状態ログを行うので少し余裕を持たせる
CONFIG_ESP_MAIN_TASK_STACK_SIZE=6144
# ---- 省電力（ESP-IDF examples/bluetooth/nimble/power_save/sdkconfig.40m.esp32s3 に準拠） ----
# Freenove / XIAO ESP32S3 には32kHz水晶がないので、BLEの低電力クロックはメイン水晶(40MHz)を使い、
# ライトスリープ中もメイン水晶を止めない（BLE接続を維持できる。ライトスリープ電流は約3mA）
CONFIG_PM_ENABLE=y
CONFIG_FREERTOS_USE_TICKLESS_IDLE=y
CONFIG_FREERTOS_HZ=1000
CONFIG_FREERTOS_IDLE_TIME_BEFORE_SLEEP=3
CONFIG_BT_CTRL_MODEM_SLEEP=y
CONFIG_BT_CTRL_MODEM_SLEEP_MODE_1=y
CONFIG_BT_CTRL_LPCLK_SEL_MAIN_XTAL=y
CONFIG_BT_CTRL_MAIN_XTAL_PU_DURING_LIGHT_SLEEP=y
CONFIG_ESP_PHY_MAC_BB_PD=y
```

## firmware/receiver/main/Kconfig.projbuild
```kconfig
menu "KeyRelay"

config YD_OTP_KEYBOARD
    bool "OTP keyboard interface (types the key's OTP on touch)"
    default y
    help
        The receiver shows up as a USB keyboard so that the security key's OTP can be typed when
        you touch it. If you do not use OTPs, turn this off: the receiver then has no keyboard
        interface at all (FIDO + smart card only), which removes the keystroke-injection risk
        described in SECURITY.md. OTP challenge-response through the FIDO interface keeps working.

        OTP（タッチでの入力）を使わないなら n。レシーバーからキーボードの口がなくなり、
        SECURITY.md の「キー入力の差し込み」の危険がなくなる。

choice YD_OTP_KBD_FILTER
    prompt "Keys the OTP keyboard may type"
    depends on YD_OTP_KEYBOARD
    default YD_OTP_KBD_FILTER_MODHEX
    help
        What the receiver is allowed to type when key reports arrive from the desk unit.

        "Yubico OTP only" types only what a Yubico OTP (the factory setting of slot 1) looks like:
        32 to 64 ModHex letters without modifier keys, then at most one Enter. Someone who stole the
        pairing key and poses as your desk unit can then not type commands, or press Enter after a
        short word, on your computer.

        Choose "Any key" if a slot types a static password, an OATH-HOTP code (digits) or uses the
        Tab options.

        既定の「Yubico OTP only」は、Yubico OTP（スロット1の出荷時の設定）の形のもの、つまり
        修飾キーなしの ModHex 32〜64 文字と、そのあとの Enter 1回しか打たない。ペアリング用の鍵を盗んで
        机上ユニットになりすました相手に、コマンドや短い単語＋Enter を打ち込まれないようにするため。
        静的パスワード・OATH-HOTP（数字）・Tab の設定を使うスロットがあるなら「Any key」にする。

    config YD_OTP_KBD_FILTER_MODHEX
        bool "Yubico OTP only (32-64 ModHex letters, then Enter)"

    config YD_OTP_KBD_FILTER_NONE
        bool "Any key (static passwords, OATH-HOTP, Tab)"
endchoice

endmenu
```

## firmware/receiver/sdkconfig.defaults
```kconfig
CONFIG_IDF_TARGET="esp32s3"
# ログはUART0（ボードの「COM」側USB-C）に出す。ネイティブUSBはMacへのFIDOデバイス用
CONFIG_ESP_CONSOLE_UART_DEFAULT=y
CONFIG_ESP_CONSOLE_SECONDARY_NONE=y
CONFIG_ESPTOOLPY_FLASHSIZE_8MB=y
# TinyUSB: 標準のHIDクラスは使わない（FIDO・OTPキーボードとも自前ドライバー hid_dev.c）
CONFIG_TINYUSB_HID_COUNT=0
CONFIG_TINYUSB_CDC_ENABLED=n
CONFIG_TINYUSB_MSC_ENABLED=n
# 1ms tick（USBの待ち処理を細かく）
CONFIG_FREERTOS_HZ=1000
# ---- BLE（NimBLE） ----
CONFIG_BT_ENABLED=y
CONFIG_BT_NIMBLE_ENABLED=y
CONFIG_BT_BLUEDROID_ENABLED=n
CONFIG_BT_NIMBLE_MAX_CONNECTIONS=1
CONFIG_BT_NIMBLE_NVS_PERSIST=y
CONFIG_BT_NIMBLE_SM_SC=y
CONFIG_BT_NIMBLE_LOG_LEVEL_WARNING=y
CONFIG_BT_NIMBLE_MSYS_1_BLOCK_COUNT=24
# NimBLE + USB でアプリが大きくなるので1.5MBのアプリ領域に
CONFIG_PARTITION_TABLE_CUSTOM=y
CONFIG_PARTITION_TABLE_CUSTOM_FILENAME="partitions.csv"
# Link protocol v2: X25519 for forward secrecy (yd_sec)
CONFIG_MBEDTLS_ECP_C=y
CONFIG_MBEDTLS_ECDH_C=y
CONFIG_MBEDTLS_ECP_DP_CURVE25519_ENABLED=y
```
